## esp/sdkconfig.defaults
```kconfig
CONFIG_APP_BUILD_TYPE_RAM=y
CONFIG_APP_BUILD_TYPE_PURE_RAM_APP=y
CONFIG_APP_NO_BLOBS=y
CONFIG_BOOTLOADER_COMPILER_OPTIMIZATION_SIZE=y
CONFIG_BOOTLOADER_LOG_LEVEL_VERBOSE=y
CONFIG_LOG_DEFAULT_LEVEL_VERBOSE=y
CONFIG_PARTITION_TABLE_SINGLE_APP=y
CONFIG_COMPILER_OPTIMIZATION_DEBUG=y
CONFIG_COMPILER_OPTIMIZATION_ASSERTIONS_ENABLE=y
CONFIG_COMPILER_CXX_EXCEPTIONS=n
CONFIG_COMPILER_CXX_RTTI=n
CONFIG_IDF_EXPERIMENTAL_FEATURES=n

CONFIG_ETH_ENABLED=y
CONFIG_ESP_WIFI_ENABLED=n
CONFIG_LWIP_ENABLE=n
CONFIG_ETH_USE_ESP32_EMAC=n
CONFIG_ETH_USE_SPI_ETHERNET=n
CONFIG_ESP_NETIF_ENABLED=n
CONFIG_ESP_MAC_ADDR_UNIVERSE_WIFI=n
CONFIG_ESP_MAC_ADDR_UNIVERSE_BT=n
CONFIG_BT_ENABLED=n
CONFIG_MQTT_PROTOCOL_311=n
CONFIG_MQTT_TRANSPORT_SSL=n
CONFIG_MQTT_TRANSPORT_WEBSOCKET=n
```
